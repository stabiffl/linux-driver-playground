## drivers/net/bshdbus/dbus2/Kconfig
```kconfig
# SPDX-License-Identifier: GPL-2.0-only
menu "BSH D-Bus-2 Drivers"

config BSHDBUS_DBUS2_SN0200421
	depends on SPI
	tristate "BSH D-Bus-2 SN0200421 driver"
	default y
	help
	  BSH D-Bus-2 driver for Texas Instruments SN0200421 chip.

config BSHDBUS_DBUS2_TEST
	tristate "BSH D-Bus-2 test driver"
	default n
	help
	  Testing driver for BSH D-Bus-2 subsystem.

endmenu
```

## net/bshdbus/Kconfig
```kconfig
# SPDX-License-Identifier: GPL-2.0-only
#
# BSH D-Bus layer core configuration
#
menuconfig BSHDBUS
	depends on NET
	tristate "BSH D-Bus subsystem support"
	help
	  BSH D-Bus is the bus which is used in BSH household appliances for the
	  communication between electronic control units.

	  If you want BSH D-Bus support you should say Y here and also to the
	  specific driver for your controller below.

if BSHDBUS

source "drivers/net/bshdbus/Kconfig"

endif
```
